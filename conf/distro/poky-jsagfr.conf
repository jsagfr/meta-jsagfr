## conf/distro/poky-jsagfr.conf
```bitbake
require conf/distro/poky.conf

DISTRO_FEATURES += "ssh-server-openssh"
# DISTRO_FEATURES += "systemd ssh-server-openssh"

# DISTRO_FEATURES_append = " systemd"
# VIRTUAL-RUNTIME_init_manager = "systemd"
# DISTRO_FEATURES_BACKFILL_CONSIDERED = "sysvinit"


DISTRO = "poky-jsagfr"
DISTROOVERRIDES = "poky"
```
